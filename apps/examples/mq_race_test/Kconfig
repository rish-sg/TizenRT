## apps/examples/mq_race_test/Kconfig
```kconfig
#
# For a description of the syntax of this configuration file,
# see kconfig-language at https://www.kernel.org/doc/Documentation/kbuild/kconfig-language.txt
#

config EXAMPLES_MQ_RACE_TEST
	bool "Message queue race condition test"
	default n
	depends on !DISABLE_MQUEUE
	---help---
		Enable the message queue race condition test that triggers the
		assert in mq_dosend() when a task waiting on mq_receive() is
		deleted via task_delete() while another task sends a message.

config USER_ENTRYPOINT
	string
	default "mq_race_test_main" if ENTRY_MQ_RACE_TEST
```

## apps/examples/pthread_cond_perf/Kconfig
```kconfig
config EXAMPLES_PTHREAD_COND_PERF
	bool "Pthread Condition Variable Performance Benchmark"
	default n
	help
	  Enable pthread condition variable performance benchmark tests.
	  Measures latency, throughput, and overhead of pthread_cond_* APIs.
	  Available as 'pthread_cond_perf' command in TASH shell.
```

## apps/examples/pthread_cond_tests/Kconfig
```kconfig
config EXAMPLES_PTHREAD_COND_TESTS
    bool "Pthread Condition Variable Tests"
    default n
    help
      Enable pthread condition variable tests that validate the sem_s structure
      modifications and pthread_cond_* API changes. Available as 'pthread_cond_tests'
      command in TASH shell.
```

## apps/examples/sem_cancel_test/Kconfig
```kconfig
#
# For a description of the syntax of this configuration file,
# see kconfig-language at https://www.kernel.org/doc/Documentation/kbuild/kconfig-language.txt
#

config EXAMPLES_SEM_CANCEL_TEST
	bool "Semaphore cancellation test"
	default n
	depends on !DISABLE_PTHREAD
	---help---
		Enable test for pthread cancellation while blocked in sem_wait().
		Verifies that ECANCELED is not returned from sem_wait() (POSIX compliance)
		and that cleanup handlers are called correctly.

if EXAMPLES_SEM_CANCEL_TEST

config EXAMPLES_SEM_CANCEL_TEST_STACKSIZE
	int "Test thread stack size"
	default 8192
	---help---
		Size of the stack used to create test threads. Default is 8192.

endif # EXAMPLES_SEM_CANCEL_TEST
```

## apps/examples/sigrace7a/Kconfig
```kconfig
#
# For a description of the syntax of this configuration file,
# see kconfig-language at https://www.kernel.org/doc/Documentation/kbuild/kconfig-language.txt
#

config EXAMPLES_SIGRACE7A
	bool "Signal race reproducer for ARMv7-A"
	default n
	depends on ARCH_ARMV7A_FAMILY
	depends on !DISABLE_SIGNALS
	---help---
		Test app to verify signal delivery behavior on ARMv7-A architecture.
		Reproduces the scenario that caused IACCVIOL crashes on ARMv8-M
		(TizenRT 4.0) by signalling a task from within a nested interrupt
		handler. ARMv7-A should always pass this test as
		arm_schedulesigaction.c unconditionally sets CPSR to privileged
		System mode (PSR_MODE_SYS) for signal delivery, with no
		conditional logic that could miss a case.

		Usage: Run 'sigrace7a' from TASH console.
		Expected: PASS on ARMv7-A (TizenRT 5.0)

config USER_ENTRYPOINT
	string
	default "sigrace7a_main" if ENTRY_SIGRACE7A
```
